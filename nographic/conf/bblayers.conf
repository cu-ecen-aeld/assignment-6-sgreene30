## nographic/conf/bblayers.conf
```bitbake
# POKY_BBLAYERS_CONF_VERSION is increased each time build/conf/bblayers.conf
# changes incompatibly
POKY_BBLAYERS_CONF_VERSION = "2"

BBPATH = "${TOPDIR}"
BBFILES ?= ""

BBLAYERS ?= " \
  /home/sgreene30/6assignment/poky/meta \
  /home/sgreene30/6assignment/poky/meta-poky \
  /home/sgreene30/6assignment/poky/meta-yocto-bsp \
  "
```
